## boot/zephyr/boards/lpcxpresso55s28.conf
```kconfig
CONFIG_BOOT_MAX_IMG_SECTORS=512
CONFIG_BOOT_SWAP_USING_STATUS=y
CONFIG_BOOT_BOOT_MAX_ALIGN=512

# match in application build
# CONFIG_MCUBOOT_BOOT_MAX_ALIGN=512
# CONFIG_MCUBOOT_MAX_IMG_SECTORS=512
# CONFIG_MCUBOOT_TRAILER_SWAP_STATUS_TYPE=y
```
